## conf/layer.conf
```bitbake
BBPATH .= ":${LAYERDIR}"
BBFILES += "${LAYERDIR}/recipes-*/*/*.bb ${LAYERDIR}/recipes-*/*/*.bbappend"
BBFILE_COLLECTIONS += "meta-loginlogs"
BBFILE_PATTERN_meta-loginlogs = "^${LAYERDIR}/"
BBFILE_PRIORITY_meta-loginlogs = "10"
LAYERDEPENDS_meta-loginlogs = "core"
LAYERSERIES_COMPAT_meta-loginlogs = "blacksail wrynose"
```
